## base_external/package/ldd/Config.in
```kconfig
config BR2_PACKAGE_LDD
	bool "ldd"
	help
	  Includes the linux kernel modules to be built and install in buildroot.
	  Used to understand buildroot external trees and package builds.
```
